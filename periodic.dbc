VERSION ""

NS_ :

BS_:

BU_: Node_1

BO_ 16 SMessage_1: 8 Vector__XXX
 SG_ Signal_1 : 0|8@1- (1,0) [0|0] ""  Node_1

BA_DEF_  "BusType" STRING ;
BA_DEF_DEF_  "BusType" "";
BA_ "BusType" "CAN";
